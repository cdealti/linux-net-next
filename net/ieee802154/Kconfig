## net/ieee802154/Kconfig
```kconfig
config IEEE802154
        tristate "IEEE Std 802.15.4 Low-Rate Wireless Personal Area Networks support"
        ---help---
          IEEE Std 802.15.4 defines a low data rate, low power and low
          complexity short range wireless personal area networks. It was
          designed to organise networks of sensors, switches, etc automation
          devices. Maximum allowed data rate is 250 kb/s and typical personal
          operating space around 10m.

          Say Y here to compile LR-WPAN support into the kernel or say M to
          compile it as modules.

config MAC802154
	tristate "Generic IEEE 802.15.4 Soft Networking Stack (mac802154)"
	depends on IEEE802154
	select CRC_CCITT
	---help---
	  This option enables the hardware independent IEEE 802.15.4
	  networking stack for SoftMAC devices (the ones implementing
	  only PHY level of IEEE 802.15.4 standard).

	  Note: this implementation is neither certified, nor feature
	  complete! Compatibility with other implementations hasn't
	  been tested yet!

	  If you plan to use HardMAC IEEE 802.15.4 devices, you can
	  say N here. Alternatievly you can say M to compile it as
	  module.
```
